## build/Kconfig/arch/Kconfig
```kconfig
# Load Zephyr Arch Kconfig descriptions.
osource "/home/pughal/zephyrproject/zephyr/arch/tricore/Kconfig"
osource "/home/pughal/zephyrproject/zephyr/arch/hexagon/Kconfig"
osource "/home/pughal/zephyrproject/zephyr/arch/rx/Kconfig"
osource "/home/pughal/zephyrproject/zephyr/arch/x86/Kconfig"
osource "/home/pughal/zephyrproject/zephyr/arch/xtensa/Kconfig"
osource "/home/pughal/zephyrproject/zephyr/arch/sparc/Kconfig"
osource "/home/pughal/zephyrproject/zephyr/arch/riscv/Kconfig"
osource "/home/pughal/zephyrproject/zephyr/arch/posix/Kconfig"
osource "/home/pughal/zephyrproject/zephyr/arch/openrisc/Kconfig"
osource "/home/pughal/zephyrproject/zephyr/arch/mips/Kconfig"
osource "/home/pughal/zephyrproject/zephyr/arch/arm64/Kconfig"
osource "/home/pughal/zephyrproject/zephyr/arch/arm/Kconfig"
osource "/home/pughal/zephyrproject/zephyr/arch/arc/Kconfig"
```

## build/Kconfig/boards/Kconfig
```kconfig
# Load Zephyr board Kconfig descriptions.
osource "/home/pughal/zephyrproject/zephyr/boards/st/stm32f4_disco/Kconfig"
```

## build/Kconfig/boards/Kconfig.defconfig
```kconfig
# Load Zephyr board defconfig descriptions.
osource "/home/pughal/zephyrproject/zephyr/boards/st/stm32f4_disco/Kconfig.defconfig"
```

## build/Kconfig/boards/Kconfig.sysbuild
```kconfig
# Load Sysbuild board Kconfig descriptions.
osource "/home/pughal/zephyrproject/zephyr/boards/st/stm32f4_disco/Kconfig.sysbuild"
```
